// tb_real_layer -- end-to-end integer check of a REAL YOLOv5n layer.
//
// Layer 10 of yolov5n-garbage: 1x1, 256 -> 128, 10x10 input, SiLU.
// Generated by scripts/gen_real_layer.py; the golden bytes come from the
// independent integer reference (integer MAC, int32 bias, (acc*M)>>15 with
// round-half-away-from-zero, clip, int8 SiLU table), and that reference is
// itself checked against the float layer output (cosine 0.9987).
//
// The comparison is element-wise over all 12,800 output bytes.  A missing
// vector file is fatal: the previous closed-loop test passed with no input at
// all because $fscanf on a null descriptor silently returns X.
`timescale 1ns/1ps

module tb_real_layer;

    parameter integer CIN    = 256;
    parameter integer COUT   = 128;
    parameter integer W      = 10;
    parameter integer H      = 10;
    parameter integer K      = 1;
    parameter integer STRIDE = 1;
    parameter integer ACT    = 2;

    localparam integer PAD  = K / 2;
    localparam integer OW   = (W + 2 * PAD - K) / STRIDE + 1;
    localparam integer OH   = (H + 2 * PAD - K) / STRIDE + 1;
    localparam integer INSZ = W * H * CIN;
    localparam integer WSZ  = COUT * CIN * K * K;
    localparam integer OSZ  = OW * OH * COUT;
    localparam integer MEMW = 131072;

    localparam [31:0] A_SRC_IN = 32'h0000_0000;
    localparam [31:0] A_SRC_W  = 32'h0002_0000;
    localparam [31:0] A_SRC_B  = 32'h0004_0000;
    localparam [31:0] A_SRC_M  = 32'h0004_0200;
    localparam [31:0] A_DST    = 32'h0004_0400;

    reg clk = 0, rstn = 0;
    always #5 clk = ~clk;

    reg  [7:0]  s_awaddr = 0;
    reg         s_awvalid = 0;
    reg  [31:0] s_wdata = 0;
    reg         s_wvalid = 0;
    wire        s_awready, s_wready, s_bvalid, s_rvalid;
    wire [1:0]  s_bresp, s_rresp;
    wire [31:0] s_rdata;
    reg         s_bready = 1, s_rready = 1;
    reg  [7:0]  s_araddr = 0;
    reg         s_arvalid = 0;

    wire [31:0] m_araddr, m_awaddr, m_wdata;
    wire        m_arvalid, m_awvalid, m_wvalid, m_wlast, m_bready, m_rready;
    wire [7:0]  m_arlen, m_awlen;
    reg  [31:0] m_rdata = 0;
    reg         m_rvalid = 0;
    reg  [1:0]  m_rresp = 0, m_bresp = 0;
    reg         m_bvalid = 0;
    wire        m_arready, m_awready, m_wready;
    assign m_arready = 1'b1;
    assign m_awready = 1'b1;
    assign m_wready  = 1'b1;

    wire busy, done, err;

    acc_shell #(.CIN(CIN), .COUT(COUT), .W(W), .H(H), .K(K),
                .STRIDE(STRIDE), .ACT(ACT)) dut (
        .clk(clk), .rstn(rstn),
        .s_awaddr(s_awaddr), .s_awvalid(s_awvalid), .s_awready(s_awready),
        .s_wdata(s_wdata), .s_wvalid(s_wvalid), .s_wready(s_wready),
        .s_bresp(s_bresp), .s_bvalid(s_bvalid), .s_bready(s_bready),
        .s_araddr(s_araddr), .s_arvalid(s_arvalid), .s_arready(s_arready),
        .s_rdata(s_rdata), .s_rresp(s_rresp), .s_rvalid(s_rvalid), .s_rready(s_rready),
        .m_araddr(m_araddr), .m_arvalid(m_arvalid), .m_arready(m_arready), .m_arlen(m_arlen),
        .m_rdata(m_rdata), .m_rvalid(m_rvalid), .m_rready(m_rready), .m_rresp(m_rresp),
        .m_awaddr(m_awaddr), .m_awvalid(m_awvalid), .m_awready(m_awready), .m_awlen(m_awlen),
        .m_wdata(m_wdata), .m_wvalid(m_wvalid), .m_wlast(m_wlast), .m_wready(m_wready),
        .m_bresp(m_bresp), .m_bvalid(m_bvalid), .m_bready(m_bready),
        .busy(busy), .done(done), .err(err)
    );

    reg [31:0] mem [0:MEMW-1];

    always @(posedge clk) begin
        m_rvalid <= 1'b0;
        if (m_arvalid && m_arready) begin
            m_rdata  <= mem[m_araddr[18:2]];
            m_rresp  <= 2'b00;
            m_rvalid <= 1'b1;
        end
        if (m_awvalid && m_awready && m_wvalid && m_wready) begin
            mem[m_awaddr[18:2]] <= {24'd0, m_wdata[7:0]};
            m_bvalid <= 1'b1;
            m_bresp  <= 2'b00;
        end
        else if (m_bvalid && m_bready)
            m_bvalid <= 1'b0;
    end

    task axil_w(input [7:0] a, input [31:0] d);
        begin
            @(negedge clk); s_awaddr = a; s_wdata = d; s_awvalid = 1; s_wvalid = 1;
            @(negedge clk); s_awvalid = 0; s_wvalid = 0;
            @(negedge clk);
        end
    endtask

    task axil_r(input [7:0] a, output [31:0] d);
        begin
            @(negedge clk); s_araddr = a; s_arvalid = 1;
            @(negedge clk); s_arvalid = 0;
            while (!s_rvalid) @(negedge clk);
            d = s_rdata;
            @(negedge clk);
        end
    endtask

    integer f, i, v, errors, guard;
    integer oc_bad [0:COUT-1];
    reg [7:0] gold;
    reg [31:0] st;

    initial begin
        for (i = 0; i < COUT; i = i + 1) oc_bad[i] = 0;
        f = $fopen("layer10/in.hex", "r");
        if (f == 0) $fatal(1, "cannot open layer10/in.hex");
        for (i = 0; i < INSZ; i = i + 1) begin
            v = 0;
            $fscanf(f, "%h", v);
            mem[(A_SRC_IN >> 2) + i] = {24'd0, v[7:0]};
        end
        $fclose(f);

        f = $fopen("layer10/w.hex", "r");
        if (f == 0) $fatal(1, "cannot open layer10/w.hex");
        for (i = 0; i < WSZ; i = i + 1) begin
            v = 0;
            $fscanf(f, "%h", v);
            mem[(A_SRC_W >> 2) + i] = {24'd0, v[7:0]};
        end
        $fclose(f);

        f = $fopen("layer10/bias.hex", "r");
        if (f == 0) $fatal(1, "cannot open layer10/bias.hex");
        for (i = 0; i < COUT; i = i + 1) begin
            v = 0;
            $fscanf(f, "%h", v);
            mem[(A_SRC_B >> 2) + i] = v;
        end
        $fclose(f);

        f = $fopen("layer10/m.hex", "r");
        if (f == 0) $fatal(1, "cannot open layer10/m.hex");
        for (i = 0; i < COUT; i = i + 1) begin
            v = 0;
            $fscanf(f, "%h", v);
            mem[(A_SRC_M >> 2) + i] = v;
        end
        $fclose(f);

        rstn = 0;
        repeat (3) @(negedge clk);
        rstn = 1;
        @(negedge clk);

        errors = 0;
        axil_w(8'h08, A_SRC_IN);
        axil_w(8'h0C, A_SRC_W);
        axil_w(8'h18, A_SRC_B);
        axil_w(8'h1C, A_SRC_M);
        axil_w(8'h10, A_DST);
        axil_w(8'h00, 32'd1);
        guard = 0;
        st = 0;
        while (!st[1] && !st[2] && guard < 2000000) begin
            axil_r(8'h04, st);
            guard = guard + 1;
        end
        if (!st[1]) begin
            $display("FAIL: never done (status=%08x guard=%0d)", st, guard);
            errors = errors + 1;
        end
        else begin
            $display("done=1 err=%0d cycles=%0d", st[2], dut.r_cycles);
            f = $fopen("layer10/gold.hex", "r");
            if (f == 0) $fatal(1, "cannot open layer10/gold.hex");
            for (i = 0; i < OSZ; i = i + 1) begin
                v = 0;
                $fscanf(f, "%h", v);
                gold = v[7:0];
                if (mem[(A_DST >> 2) + i][7:0] !== gold) begin
                    if (errors < 10)
                        $display("MISMATCH out[%0d] y=%0d x=%0d oc=%0d got %02h want %02h",
                                 i, i/(OW*COUT), (i/COUT)%OW, i%COUT,
                                 mem[(A_DST >> 2) + i][7:0], gold);
                    errors = errors + 1;
                    oc_bad[i % COUT] = oc_bad[i % COUT] + 1;
                end
            end
            $fclose(f);
            begin : chk_params
                integer eb, em;
                eb = 0; em = 0;
                f = $fopen("layer10/bias.hex", "r");
                for (i = 0; i < COUT; i = i + 1) begin
                    v = 0; $fscanf(f, "%h", v);
                    if (dut.u_layer.bias_ram[i] !== v) begin
                        if (eb < 5) $display("  bias[%0d] got %08x want %08x", i, dut.u_layer.bias_ram[i], v);
                        eb = eb + 1;
                    end
                end
                $fclose(f);
                f = $fopen("layer10/m.hex", "r");
                for (i = 0; i < COUT; i = i + 1) begin
                    v = 0; $fscanf(f, "%h", v);
                    if (dut.u_layer.m_ram[i] !== v) begin
                        if (em < 5) $display("  m[%0d] got %08x want %08x", i, dut.u_layer.m_ram[i], v);
                        em = em + 1;
                    end
                end
                $fclose(f);
                $display("PARAM-CHECK bias bad=%0d m bad=%0d", eb, em);
            end
            $write("FIRST got :");
            for (i = 0; i < COUT; i = i + 1)
                $write(" %02h", mem[(A_DST >> 2) + i][7:0]);
            $write("\nFIRST want:");
            f = $fopen("layer10/gold.hex", "r");
            for (i = 0; i < COUT; i = i + 1) begin
                v = 0;
                $fscanf(f, "%h", v);
                $write(" %02h", v[7:0]);
            end
            $fclose(f);
            $write("\n");
            $display("BYTES checked=%0d mismatches=%0d", OSZ, errors);
            for (i = 0; i < COUT; i = i + 1)
                if (oc_bad[i] != 0)
                    $display("  oc %0d bad %0d/%0d", i, oc_bad[i], OW*OH);
        end

        if (errors == 0) $display("RESULT: real YOLO layer integer closed loop PASS");
        else             $display("RESULT: real YOLO layer FAIL (%0d)", errors);
        $finish;
    end

    initial begin
        #50000000;
        $display("FAIL: global timeout");
        $finish;
    end

endmodule
